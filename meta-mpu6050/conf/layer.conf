## meta-mpu6050/conf/layer.conf
```bitbake
# We have a conf and classes directory, add to BBPATH
BBPATH .= ":${LAYERDIR}"

# We have recipes-* directories, add to BBFILES
BBFILES += "${LAYERDIR}/recipes-*/*/*.bb \
            ${LAYERDIR}/recipes-*/*/*.bbappend"

BBFILE_COLLECTIONS += "meta-mpu6050"
BBFILE_PATTERN_meta-mpu6050 = "^${LAYERDIR}/"
BBFILE_PRIORITY_meta-mpu6050 = "6"

LAYERDEPENDS_meta-mpu6050 = "core"
LAYERSERIES_COMPAT_meta-mpu6050 = "kirkstone"
```
